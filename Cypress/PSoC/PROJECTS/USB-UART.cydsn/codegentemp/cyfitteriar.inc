#ifndef INCLUDED_CYFITTERIAR_INC
#define INCLUDED_CYFITTERIAR_INC
    INCLUDE cydeviceiar_trm.inc

/* UART_rx */
UART_rx__0__DR EQU CYREG_GPIO_PRT3_DR
UART_rx__0__DR_CLR EQU CYREG_GPIO_PRT3_DR_CLR
UART_rx__0__DR_INV EQU CYREG_GPIO_PRT3_DR_INV
UART_rx__0__DR_SET EQU CYREG_GPIO_PRT3_DR_SET
UART_rx__0__HSIOM EQU CYREG_HSIOM_PORT_SEL3
UART_rx__0__HSIOM_MASK EQU 0x000F0000
UART_rx__0__HSIOM_SHIFT EQU 16
UART_rx__0__INTCFG EQU CYREG_GPIO_PRT3_INTR_CFG
UART_rx__0__INTR EQU CYREG_GPIO_PRT3_INTR
UART_rx__0__INTR_CFG EQU CYREG_GPIO_PRT3_INTR_CFG
UART_rx__0__INTSTAT EQU CYREG_GPIO_PRT3_INTR
UART_rx__0__MASK EQU 0x10
UART_rx__0__PA__CFG0 EQU CYREG_UDB_PA3_CFG0
UART_rx__0__PA__CFG1 EQU CYREG_UDB_PA3_CFG1
UART_rx__0__PA__CFG10 EQU CYREG_UDB_PA3_CFG10
UART_rx__0__PA__CFG11 EQU CYREG_UDB_PA3_CFG11
UART_rx__0__PA__CFG12 EQU CYREG_UDB_PA3_CFG12
UART_rx__0__PA__CFG13 EQU CYREG_UDB_PA3_CFG13
UART_rx__0__PA__CFG14 EQU CYREG_UDB_PA3_CFG14
UART_rx__0__PA__CFG2 EQU CYREG_UDB_PA3_CFG2
UART_rx__0__PA__CFG3 EQU CYREG_UDB_PA3_CFG3
UART_rx__0__PA__CFG4 EQU CYREG_UDB_PA3_CFG4
UART_rx__0__PA__CFG5 EQU CYREG_UDB_PA3_CFG5
UART_rx__0__PA__CFG6 EQU CYREG_UDB_PA3_CFG6
UART_rx__0__PA__CFG7 EQU CYREG_UDB_PA3_CFG7
UART_rx__0__PA__CFG8 EQU CYREG_UDB_PA3_CFG8
UART_rx__0__PA__CFG9 EQU CYREG_UDB_PA3_CFG9
UART_rx__0__PC EQU CYREG_GPIO_PRT3_PC
UART_rx__0__PC2 EQU CYREG_GPIO_PRT3_PC2
UART_rx__0__PORT EQU 3
UART_rx__0__PS EQU CYREG_GPIO_PRT3_PS
UART_rx__0__SHIFT EQU 4
UART_rx__DR EQU CYREG_GPIO_PRT3_DR
UART_rx__DR_CLR EQU CYREG_GPIO_PRT3_DR_CLR
UART_rx__DR_INV EQU CYREG_GPIO_PRT3_DR_INV
UART_rx__DR_SET EQU CYREG_GPIO_PRT3_DR_SET
UART_rx__INTCFG EQU CYREG_GPIO_PRT3_INTR_CFG
UART_rx__INTR EQU CYREG_GPIO_PRT3_INTR
UART_rx__INTR_CFG EQU CYREG_GPIO_PRT3_INTR_CFG
UART_rx__INTSTAT EQU CYREG_GPIO_PRT3_INTR
UART_rx__MASK EQU 0x10
UART_rx__PA__CFG0 EQU CYREG_UDB_PA3_CFG0
UART_rx__PA__CFG1 EQU CYREG_UDB_PA3_CFG1
UART_rx__PA__CFG10 EQU CYREG_UDB_PA3_CFG10
UART_rx__PA__CFG11 EQU CYREG_UDB_PA3_CFG11
UART_rx__PA__CFG12 EQU CYREG_UDB_PA3_CFG12
UART_rx__PA__CFG13 EQU CYREG_UDB_PA3_CFG13
UART_rx__PA__CFG14 EQU CYREG_UDB_PA3_CFG14
UART_rx__PA__CFG2 EQU CYREG_UDB_PA3_CFG2
UART_rx__PA__CFG3 EQU CYREG_UDB_PA3_CFG3
UART_rx__PA__CFG4 EQU CYREG_UDB_PA3_CFG4
UART_rx__PA__CFG5 EQU CYREG_UDB_PA3_CFG5
UART_rx__PA__CFG6 EQU CYREG_UDB_PA3_CFG6
UART_rx__PA__CFG7 EQU CYREG_UDB_PA3_CFG7
UART_rx__PA__CFG8 EQU CYREG_UDB_PA3_CFG8
UART_rx__PA__CFG9 EQU CYREG_UDB_PA3_CFG9
UART_rx__PC EQU CYREG_GPIO_PRT3_PC
UART_rx__PC2 EQU CYREG_GPIO_PRT3_PC2
UART_rx__PORT EQU 3
UART_rx__PS EQU CYREG_GPIO_PRT3_PS
UART_rx__SHIFT EQU 4

/* UART_SCB */
UART_SCB__CTRL EQU CYREG_SCB1_CTRL
UART_SCB__EZ_DATA000 EQU CYREG_SCB1_EZ_DATA000
UART_SCB__EZ_DATA001 EQU CYREG_SCB1_EZ_DATA001
UART_SCB__EZ_DATA002 EQU CYREG_SCB1_EZ_DATA002
UART_SCB__EZ_DATA003 EQU CYREG_SCB1_EZ_DATA003
UART_SCB__EZ_DATA004 EQU CYREG_SCB1_EZ_DATA004
UART_SCB__EZ_DATA005 EQU CYREG_SCB1_EZ_DATA005
UART_SCB__EZ_DATA006 EQU CYREG_SCB1_EZ_DATA006
UART_SCB__EZ_DATA007 EQU CYREG_SCB1_EZ_DATA007
UART_SCB__EZ_DATA008 EQU CYREG_SCB1_EZ_DATA008
UART_SCB__EZ_DATA009 EQU CYREG_SCB1_EZ_DATA009
UART_SCB__EZ_DATA010 EQU CYREG_SCB1_EZ_DATA010
UART_SCB__EZ_DATA011 EQU CYREG_SCB1_EZ_DATA011
UART_SCB__EZ_DATA012 EQU CYREG_SCB1_EZ_DATA012
UART_SCB__EZ_DATA013 EQU CYREG_SCB1_EZ_DATA013
UART_SCB__EZ_DATA014 EQU CYREG_SCB1_EZ_DATA014
UART_SCB__EZ_DATA015 EQU CYREG_SCB1_EZ_DATA015
UART_SCB__EZ_DATA016 EQU CYREG_SCB1_EZ_DATA016
UART_SCB__EZ_DATA017 EQU CYREG_SCB1_EZ_DATA017
UART_SCB__EZ_DATA018 EQU CYREG_SCB1_EZ_DATA018
UART_SCB__EZ_DATA019 EQU CYREG_SCB1_EZ_DATA019
UART_SCB__EZ_DATA020 EQU CYREG_SCB1_EZ_DATA020
UART_SCB__EZ_DATA021 EQU CYREG_SCB1_EZ_DATA021
UART_SCB__EZ_DATA022 EQU CYREG_SCB1_EZ_DATA022
UART_SCB__EZ_DATA023 EQU CYREG_SCB1_EZ_DATA023
UART_SCB__EZ_DATA024 EQU CYREG_SCB1_EZ_DATA024
UART_SCB__EZ_DATA025 EQU CYREG_SCB1_EZ_DATA025
UART_SCB__EZ_DATA026 EQU CYREG_SCB1_EZ_DATA026
UART_SCB__EZ_DATA027 EQU CYREG_SCB1_EZ_DATA027
UART_SCB__EZ_DATA028 EQU CYREG_SCB1_EZ_DATA028
UART_SCB__EZ_DATA029 EQU CYREG_SCB1_EZ_DATA029
UART_SCB__EZ_DATA030 EQU CYREG_SCB1_EZ_DATA030
UART_SCB__EZ_DATA031 EQU CYREG_SCB1_EZ_DATA031
UART_SCB__I2C_CFG EQU CYREG_SCB1_I2C_CFG
UART_SCB__I2C_CTRL EQU CYREG_SCB1_I2C_CTRL
UART_SCB__I2C_M_CMD EQU CYREG_SCB1_I2C_M_CMD
UART_SCB__I2C_S_CMD EQU CYREG_SCB1_I2C_S_CMD
UART_SCB__I2C_STATUS EQU CYREG_SCB1_I2C_STATUS
UART_SCB__INTR_CAUSE EQU CYREG_SCB1_INTR_CAUSE
UART_SCB__INTR_I2C_EC EQU CYREG_SCB1_INTR_I2C_EC
UART_SCB__INTR_I2C_EC_MASK EQU CYREG_SCB1_INTR_I2C_EC_MASK
UART_SCB__INTR_I2C_EC_MASKED EQU CYREG_SCB1_INTR_I2C_EC_MASKED
UART_SCB__INTR_M EQU CYREG_SCB1_INTR_M
UART_SCB__INTR_M_MASK EQU CYREG_SCB1_INTR_M_MASK
UART_SCB__INTR_M_MASKED EQU CYREG_SCB1_INTR_M_MASKED
UART_SCB__INTR_M_SET EQU CYREG_SCB1_INTR_M_SET
UART_SCB__INTR_RX EQU CYREG_SCB1_INTR_RX
UART_SCB__INTR_RX_MASK EQU CYREG_SCB1_INTR_RX_MASK
UART_SCB__INTR_RX_MASKED EQU CYREG_SCB1_INTR_RX_MASKED
UART_SCB__INTR_RX_SET EQU CYREG_SCB1_INTR_RX_SET
UART_SCB__INTR_S EQU CYREG_SCB1_INTR_S
UART_SCB__INTR_S_MASK EQU CYREG_SCB1_INTR_S_MASK
UART_SCB__INTR_S_MASKED EQU CYREG_SCB1_INTR_S_MASKED
UART_SCB__INTR_S_SET EQU CYREG_SCB1_INTR_S_SET
UART_SCB__INTR_SPI_EC EQU CYREG_SCB1_INTR_SPI_EC
UART_SCB__INTR_SPI_EC_MASK EQU CYREG_SCB1_INTR_SPI_EC_MASK
UART_SCB__INTR_SPI_EC_MASKED EQU CYREG_SCB1_INTR_SPI_EC_MASKED
UART_SCB__INTR_TX EQU CYREG_SCB1_INTR_TX
UART_SCB__INTR_TX_MASK EQU CYREG_SCB1_INTR_TX_MASK
UART_SCB__INTR_TX_MASKED EQU CYREG_SCB1_INTR_TX_MASKED
UART_SCB__INTR_TX_SET EQU CYREG_SCB1_INTR_TX_SET
UART_SCB__RX_CTRL EQU CYREG_SCB1_RX_CTRL
UART_SCB__RX_FIFO_CTRL EQU CYREG_SCB1_RX_FIFO_CTRL
UART_SCB__RX_FIFO_RD EQU CYREG_SCB1_RX_FIFO_RD
UART_SCB__RX_FIFO_RD_SILENT EQU CYREG_SCB1_RX_FIFO_RD_SILENT
UART_SCB__RX_FIFO_STATUS EQU CYREG_SCB1_RX_FIFO_STATUS
UART_SCB__RX_MATCH EQU CYREG_SCB1_RX_MATCH
UART_SCB__SPI_CTRL EQU CYREG_SCB1_SPI_CTRL
UART_SCB__SPI_STATUS EQU CYREG_SCB1_SPI_STATUS
UART_SCB__SS0_POSISTION EQU 0
UART_SCB__SS1_POSISTION EQU 1
UART_SCB__SS2_POSISTION EQU 2
UART_SCB__SS3_POSISTION EQU 3
UART_SCB__STATUS EQU CYREG_SCB1_STATUS
UART_SCB__TX_CTRL EQU CYREG_SCB1_TX_CTRL
UART_SCB__TX_FIFO_CTRL EQU CYREG_SCB1_TX_FIFO_CTRL
UART_SCB__TX_FIFO_STATUS EQU CYREG_SCB1_TX_FIFO_STATUS
UART_SCB__TX_FIFO_WR EQU CYREG_SCB1_TX_FIFO_WR
UART_SCB__UART_CTRL EQU CYREG_SCB1_UART_CTRL
UART_SCB__UART_FLOW_CTRL EQU CYREG_SCB1_UART_FLOW_CTRL
UART_SCB__UART_RX_CTRL EQU CYREG_SCB1_UART_RX_CTRL
UART_SCB__UART_RX_STATUS EQU CYREG_SCB1_UART_RX_STATUS
UART_SCB__UART_TX_CTRL EQU CYREG_SCB1_UART_TX_CTRL

/* UART_SCBCLK */
UART_SCBCLK__CTRL_REGISTER EQU CYREG_PERI_PCLK_CTL02
UART_SCBCLK__DIV_ID EQU 0x00000040
UART_SCBCLK__DIV_REGISTER EQU CYREG_PERI_DIV_16_CTL00
UART_SCBCLK__PA_DIV_ID EQU 0x000000FF

/* UART_tx */
UART_tx__0__DR EQU CYREG_GPIO_PRT3_DR
UART_tx__0__DR_CLR EQU CYREG_GPIO_PRT3_DR_CLR
UART_tx__0__DR_INV EQU CYREG_GPIO_PRT3_DR_INV
UART_tx__0__DR_SET EQU CYREG_GPIO_PRT3_DR_SET
UART_tx__0__HSIOM EQU CYREG_HSIOM_PORT_SEL3
UART_tx__0__HSIOM_MASK EQU 0x00F00000
UART_tx__0__HSIOM_SHIFT EQU 20
UART_tx__0__INTCFG EQU CYREG_GPIO_PRT3_INTR_CFG
UART_tx__0__INTR EQU CYREG_GPIO_PRT3_INTR
UART_tx__0__INTR_CFG EQU CYREG_GPIO_PRT3_INTR_CFG
UART_tx__0__INTSTAT EQU CYREG_GPIO_PRT3_INTR
UART_tx__0__MASK EQU 0x20
UART_tx__0__OUT_SEL EQU CYREG_UDB_PA3_CFG10
UART_tx__0__OUT_SEL_SHIFT EQU 10
UART_tx__0__OUT_SEL_VAL EQU -1
UART_tx__0__PA__CFG0 EQU CYREG_UDB_PA3_CFG0
UART_tx__0__PA__CFG1 EQU CYREG_UDB_PA3_CFG1
UART_tx__0__PA__CFG10 EQU CYREG_UDB_PA3_CFG10
UART_tx__0__PA__CFG11 EQU CYREG_UDB_PA3_CFG11
UART_tx__0__PA__CFG12 EQU CYREG_UDB_PA3_CFG12
UART_tx__0__PA__CFG13 EQU CYREG_UDB_PA3_CFG13
UART_tx__0__PA__CFG14 EQU CYREG_UDB_PA3_CFG14
UART_tx__0__PA__CFG2 EQU CYREG_UDB_PA3_CFG2
UART_tx__0__PA__CFG3 EQU CYREG_UDB_PA3_CFG3
UART_tx__0__PA__CFG4 EQU CYREG_UDB_PA3_CFG4
UART_tx__0__PA__CFG5 EQU CYREG_UDB_PA3_CFG5
UART_tx__0__PA__CFG6 EQU CYREG_UDB_PA3_CFG6
UART_tx__0__PA__CFG7 EQU CYREG_UDB_PA3_CFG7
UART_tx__0__PA__CFG8 EQU CYREG_UDB_PA3_CFG8
UART_tx__0__PA__CFG9 EQU CYREG_UDB_PA3_CFG9
UART_tx__0__PC EQU CYREG_GPIO_PRT3_PC
UART_tx__0__PC2 EQU CYREG_GPIO_PRT3_PC2
UART_tx__0__PORT EQU 3
UART_tx__0__PS EQU CYREG_GPIO_PRT3_PS
UART_tx__0__SHIFT EQU 5
UART_tx__DR EQU CYREG_GPIO_PRT3_DR
UART_tx__DR_CLR EQU CYREG_GPIO_PRT3_DR_CLR
UART_tx__DR_INV EQU CYREG_GPIO_PRT3_DR_INV
UART_tx__DR_SET EQU CYREG_GPIO_PRT3_DR_SET
UART_tx__INTCFG EQU CYREG_GPIO_PRT3_INTR_CFG
UART_tx__INTR EQU CYREG_GPIO_PRT3_INTR
UART_tx__INTR_CFG EQU CYREG_GPIO_PRT3_INTR_CFG
UART_tx__INTSTAT EQU CYREG_GPIO_PRT3_INTR
UART_tx__MASK EQU 0x20
UART_tx__PA__CFG0 EQU CYREG_UDB_PA3_CFG0
UART_tx__PA__CFG1 EQU CYREG_UDB_PA3_CFG1
UART_tx__PA__CFG10 EQU CYREG_UDB_PA3_CFG10
UART_tx__PA__CFG11 EQU CYREG_UDB_PA3_CFG11
UART_tx__PA__CFG12 EQU CYREG_UDB_PA3_CFG12
UART_tx__PA__CFG13 EQU CYREG_UDB_PA3_CFG13
UART_tx__PA__CFG14 EQU CYREG_UDB_PA3_CFG14
UART_tx__PA__CFG2 EQU CYREG_UDB_PA3_CFG2
UART_tx__PA__CFG3 EQU CYREG_UDB_PA3_CFG3
UART_tx__PA__CFG4 EQU CYREG_UDB_PA3_CFG4
UART_tx__PA__CFG5 EQU CYREG_UDB_PA3_CFG5
UART_tx__PA__CFG6 EQU CYREG_UDB_PA3_CFG6
UART_tx__PA__CFG7 EQU CYREG_UDB_PA3_CFG7
UART_tx__PA__CFG8 EQU CYREG_UDB_PA3_CFG8
UART_tx__PA__CFG9 EQU CYREG_UDB_PA3_CFG9
UART_tx__PC EQU CYREG_GPIO_PRT3_PC
UART_tx__PC2 EQU CYREG_GPIO_PRT3_PC2
UART_tx__PORT EQU 3
UART_tx__PS EQU CYREG_GPIO_PRT3_PS
UART_tx__SHIFT EQU 5

/* Miscellaneous */
CYDEV_BCLK__HFCLK__HZ EQU 24000000
CYDEV_BCLK__HFCLK__KHZ EQU 24000
CYDEV_BCLK__HFCLK__MHZ EQU 24
CYDEV_BCLK__SYSCLK__HZ EQU 24000000
CYDEV_BCLK__SYSCLK__KHZ EQU 24000
CYDEV_BCLK__SYSCLK__MHZ EQU 24
CYDEV_CHIP_DIE_LEOPARD EQU 1
CYDEV_CHIP_DIE_PANTHER EQU 6
CYDEV_CHIP_DIE_PSOC4A EQU 3
CYDEV_CHIP_DIE_PSOC5LP EQU 5
CYDEV_CHIP_DIE_UNKNOWN EQU 0
CYDEV_CHIP_FAMILY_PSOC3 EQU 1
CYDEV_CHIP_FAMILY_PSOC4 EQU 2
CYDEV_CHIP_FAMILY_PSOC5 EQU 3
CYDEV_CHIP_FAMILY_UNKNOWN EQU 0
CYDEV_CHIP_FAMILY_USED EQU CYDEV_CHIP_FAMILY_PSOC4
CYDEV_CHIP_JTAG_ID EQU 0x0E23119E
CYDEV_CHIP_MEMBER_3A EQU 1
CYDEV_CHIP_MEMBER_4A EQU 3
CYDEV_CHIP_MEMBER_4D EQU 2
CYDEV_CHIP_MEMBER_4F EQU 4
CYDEV_CHIP_MEMBER_5A EQU 6
CYDEV_CHIP_MEMBER_5B EQU 5
CYDEV_CHIP_MEMBER_UNKNOWN EQU 0
CYDEV_CHIP_MEMBER_USED EQU CYDEV_CHIP_MEMBER_4F
CYDEV_CHIP_DIE_EXPECT EQU CYDEV_CHIP_MEMBER_USED
CYDEV_CHIP_DIE_ACTUAL EQU CYDEV_CHIP_DIE_EXPECT
CYDEV_CHIP_REV_LEOPARD_ES1 EQU 0
CYDEV_CHIP_REV_LEOPARD_ES2 EQU 1
CYDEV_CHIP_REV_LEOPARD_ES3 EQU 3
CYDEV_CHIP_REV_LEOPARD_PRODUCTION EQU 3
CYDEV_CHIP_REV_PANTHER_ES0 EQU 0
CYDEV_CHIP_REV_PANTHER_ES1 EQU 1
CYDEV_CHIP_REV_PANTHER_PRODUCTION EQU 1
CYDEV_CHIP_REV_PSOC4A_ES0 EQU 17
CYDEV_CHIP_REV_PSOC4A_PRODUCTION EQU 17
CYDEV_CHIP_REV_PSOC5LP_ES0 EQU 0
CYDEV_CHIP_REV_PSOC5LP_PRODUCTION EQU 0
CYDEV_CHIP_REVISION_3A_ES1 EQU 0
CYDEV_CHIP_REVISION_3A_ES2 EQU 1
CYDEV_CHIP_REVISION_3A_ES3 EQU 3
CYDEV_CHIP_REVISION_3A_PRODUCTION EQU 3
CYDEV_CHIP_REVISION_4A_ES0 EQU 17
CYDEV_CHIP_REVISION_4A_PRODUCTION EQU 17
CYDEV_CHIP_REVISION_4D_PRODUCTION EQU 0
CYDEV_CHIP_REVISION_4F_PRODUCTION EQU 0
CYDEV_CHIP_REVISION_5A_ES0 EQU 0
CYDEV_CHIP_REVISION_5A_ES1 EQU 1
CYDEV_CHIP_REVISION_5A_PRODUCTION EQU 1
CYDEV_CHIP_REVISION_5B_ES0 EQU 0
CYDEV_CHIP_REVISION_5B_PRODUCTION EQU 0
CYDEV_CHIP_REVISION_USED EQU CYDEV_CHIP_REVISION_4F_PRODUCTION
CYDEV_CHIP_REV_EXPECT EQU CYDEV_CHIP_REVISION_USED
CYDEV_CONFIG_READ_ACCELERATOR EQU 1
CYDEV_CONFIG_UNUSED_IO_AllowButWarn EQU 0
CYDEV_CONFIG_UNUSED_IO EQU CYDEV_CONFIG_UNUSED_IO_AllowButWarn
CYDEV_CONFIG_UNUSED_IO_AllowWithInfo EQU 1
CYDEV_CONFIG_UNUSED_IO_Disallowed EQU 2
CYDEV_CONFIGURATION_COMPRESSED EQU 1
CYDEV_CONFIGURATION_MODE_COMPRESSED EQU 0
CYDEV_CONFIGURATION_MODE EQU CYDEV_CONFIGURATION_MODE_COMPRESSED
CYDEV_CONFIGURATION_MODE_DMA EQU 2
CYDEV_CONFIGURATION_MODE_UNCOMPRESSED EQU 1
CYDEV_DEBUG_PROTECT_KILL EQU 4
CYDEV_DEBUG_PROTECT_OPEN EQU 1
CYDEV_DEBUG_PROTECT EQU CYDEV_DEBUG_PROTECT_OPEN
CYDEV_DEBUG_PROTECT_PROTECTED EQU 2
CYDEV_DEBUGGING_DPS_Disable EQU 3
CYDEV_DEBUGGING_DPS_SWD EQU 2
CYDEV_DEBUGGING_DPS EQU CYDEV_DEBUGGING_DPS_SWD
CYDEV_DEBUGGING_ENABLE EQU 1
CYDEV_HEAP_SIZE EQU 0x0100
CYDEV_PROJ_TYPE EQU 0
CYDEV_PROJ_TYPE_BOOTLOADER EQU 1
CYDEV_PROJ_TYPE_LOADABLE EQU 2
CYDEV_PROJ_TYPE_MULTIAPPBOOTLOADER EQU 3
CYDEV_PROJ_TYPE_STANDARD EQU 0
CYDEV_STACK_SIZE EQU 0x0400
CYDEV_USE_BUNDLED_CMSIS EQU 1
CYDEV_VARIABLE_VDDA EQU 1
CYDEV_VDDA_MV EQU 3300
CYDEV_VDDD_MV EQU 3300
CYDEV_VDDR_MV EQU 3300
CYIPBLOCK_m0s8bless_VERSION EQU 1
CYIPBLOCK_m0s8cpussv2_VERSION EQU 1
CYIPBLOCK_m0s8csd_VERSION EQU 1
CYIPBLOCK_m0s8ioss_VERSION EQU 1
CYIPBLOCK_m0s8lcd_VERSION EQU 2
CYIPBLOCK_m0s8lpcomp_VERSION EQU 2
CYIPBLOCK_m0s8peri_VERSION EQU 1
CYIPBLOCK_m0s8scb_VERSION EQU 2
CYIPBLOCK_m0s8srssv2_VERSION EQU 1
CYIPBLOCK_m0s8tcpwm_VERSION EQU 2
CYIPBLOCK_m0s8udbif_VERSION EQU 1
CYIPBLOCK_s8pass4al_VERSION EQU 1
CYDEV_BOOTLOADER_ENABLE EQU 0

#endif /* INCLUDED_CYFITTERIAR_INC */
