#ifndef INCLUDED_CYFITTERIAR_INC
#define INCLUDED_CYFITTERIAR_INC
    INCLUDE cydeviceiar_trm.inc

/* PWM_PWMUDB */
PWM_PWMUDB_genblk1_ctrlreg__16BIT_CONTROL_AUX_CTL_REG EQU CYREG_UDB_W16_ACTL_02
PWM_PWMUDB_genblk1_ctrlreg__16BIT_CONTROL_CONTROL_REG EQU CYREG_UDB_W16_CTL_02
PWM_PWMUDB_genblk1_ctrlreg__16BIT_CONTROL_COUNT_REG EQU CYREG_UDB_W16_CTL_02
PWM_PWMUDB_genblk1_ctrlreg__16BIT_COUNT_CONTROL_REG EQU CYREG_UDB_W16_CTL_02
PWM_PWMUDB_genblk1_ctrlreg__16BIT_COUNT_COUNT_REG EQU CYREG_UDB_W16_CTL_02
PWM_PWMUDB_genblk1_ctrlreg__16BIT_MASK_MASK_REG EQU CYREG_UDB_W16_MSK_02
PWM_PWMUDB_genblk1_ctrlreg__16BIT_MASK_PERIOD_REG EQU CYREG_UDB_W16_MSK_02
PWM_PWMUDB_genblk1_ctrlreg__16BIT_PERIOD_MASK_REG EQU CYREG_UDB_W16_MSK_02
PWM_PWMUDB_genblk1_ctrlreg__16BIT_PERIOD_PERIOD_REG EQU CYREG_UDB_W16_MSK_02
PWM_PWMUDB_genblk1_ctrlreg__7__MASK EQU 0x80
PWM_PWMUDB_genblk1_ctrlreg__7__POS EQU 7
PWM_PWMUDB_genblk1_ctrlreg__CONTROL_AUX_CTL_REG EQU CYREG_UDB_W8_ACTL_02
PWM_PWMUDB_genblk1_ctrlreg__CONTROL_REG EQU CYREG_UDB_W8_CTL_02
PWM_PWMUDB_genblk1_ctrlreg__CONTROL_ST_REG EQU CYREG_UDB_CAT16_CTL_ST_02
PWM_PWMUDB_genblk1_ctrlreg__COUNT_REG EQU CYREG_UDB_W8_CTL_02
PWM_PWMUDB_genblk1_ctrlreg__COUNT_ST_REG EQU CYREG_UDB_CAT16_CTL_ST_02
PWM_PWMUDB_genblk1_ctrlreg__MASK EQU 0x80
PWM_PWMUDB_genblk1_ctrlreg__MASK_CTL_AUX_CTL_REG EQU CYREG_UDB_CAT16_ACTL_MSK_02
PWM_PWMUDB_genblk1_ctrlreg__PER_CTL_AUX_CTL_REG EQU CYREG_UDB_CAT16_ACTL_MSK_02
PWM_PWMUDB_genblk1_ctrlreg__PERIOD_REG EQU CYREG_UDB_W8_MSK_02
PWM_PWMUDB_genblk8_stsreg__0__MASK EQU 0x01
PWM_PWMUDB_genblk8_stsreg__0__POS EQU 0
PWM_PWMUDB_genblk8_stsreg__16BIT_STATUS_AUX_CTL_REG EQU CYREG_UDB_W16_ACTL_02
PWM_PWMUDB_genblk8_stsreg__16BIT_STATUS_REG EQU CYREG_UDB_W16_ST_02
PWM_PWMUDB_genblk8_stsreg__2__MASK EQU 0x04
PWM_PWMUDB_genblk8_stsreg__2__POS EQU 2
PWM_PWMUDB_genblk8_stsreg__3__MASK EQU 0x08
PWM_PWMUDB_genblk8_stsreg__3__POS EQU 3
PWM_PWMUDB_genblk8_stsreg__MASK EQU 0x0D
PWM_PWMUDB_genblk8_stsreg__MASK_REG EQU CYREG_UDB_W8_MSK_02
PWM_PWMUDB_genblk8_stsreg__MASK_ST_AUX_CTL_REG EQU CYREG_UDB_CAT16_ACTL_MSK_02
PWM_PWMUDB_genblk8_stsreg__PER_ST_AUX_CTL_REG EQU CYREG_UDB_CAT16_ACTL_MSK_02
PWM_PWMUDB_genblk8_stsreg__STATUS_AUX_CTL_REG EQU CYREG_UDB_W8_ACTL_02
PWM_PWMUDB_genblk8_stsreg__STATUS_CNT_REG EQU CYREG_UDB_CAT16_CTL_ST_02
PWM_PWMUDB_genblk8_stsreg__STATUS_CONTROL_REG EQU CYREG_UDB_CAT16_CTL_ST_02
PWM_PWMUDB_genblk8_stsreg__STATUS_REG EQU CYREG_UDB_W8_ST_02
PWM_PWMUDB_sP8_pwmdp_u0__16BIT_A0_REG EQU CYREG_UDB_W16_A0_02
PWM_PWMUDB_sP8_pwmdp_u0__16BIT_A1_REG EQU CYREG_UDB_W16_A1_02
PWM_PWMUDB_sP8_pwmdp_u0__16BIT_D0_REG EQU CYREG_UDB_W16_D0_02
PWM_PWMUDB_sP8_pwmdp_u0__16BIT_D1_REG EQU CYREG_UDB_W16_D1_02
PWM_PWMUDB_sP8_pwmdp_u0__16BIT_DP_AUX_CTL_REG EQU CYREG_UDB_W16_ACTL_02
PWM_PWMUDB_sP8_pwmdp_u0__16BIT_F0_REG EQU CYREG_UDB_W16_F0_02
PWM_PWMUDB_sP8_pwmdp_u0__16BIT_F1_REG EQU CYREG_UDB_W16_F1_02
PWM_PWMUDB_sP8_pwmdp_u0__A0_A1_REG EQU CYREG_UDB_CAT16_A_02
PWM_PWMUDB_sP8_pwmdp_u0__A0_REG EQU CYREG_UDB_W8_A0_02
PWM_PWMUDB_sP8_pwmdp_u0__A1_REG EQU CYREG_UDB_W8_A1_02
PWM_PWMUDB_sP8_pwmdp_u0__D0_D1_REG EQU CYREG_UDB_CAT16_D_02
PWM_PWMUDB_sP8_pwmdp_u0__D0_REG EQU CYREG_UDB_W8_D0_02
PWM_PWMUDB_sP8_pwmdp_u0__D1_REG EQU CYREG_UDB_W8_D1_02
PWM_PWMUDB_sP8_pwmdp_u0__DP_AUX_CTL_REG EQU CYREG_UDB_W8_ACTL_02
PWM_PWMUDB_sP8_pwmdp_u0__F0_F1_REG EQU CYREG_UDB_CAT16_F_02
PWM_PWMUDB_sP8_pwmdp_u0__F0_REG EQU CYREG_UDB_W8_F0_02
PWM_PWMUDB_sP8_pwmdp_u0__F1_REG EQU CYREG_UDB_W8_F1_02
PWM_PWMUDB_sP8_pwmdp_u0__MSK_DP_AUX_CTL_REG EQU CYREG_UDB_CAT16_ACTL_MSK_02
PWM_PWMUDB_sP8_pwmdp_u0__PER_DP_AUX_CTL_REG EQU CYREG_UDB_CAT16_ACTL_MSK_02

/* SW1 */
SW1__0__DR EQU CYREG_GPIO_PRT2_DR
SW1__0__DR_CLR EQU CYREG_GPIO_PRT2_DR_CLR
SW1__0__DR_INV EQU CYREG_GPIO_PRT2_DR_INV
SW1__0__DR_SET EQU CYREG_GPIO_PRT2_DR_SET
SW1__0__HSIOM EQU CYREG_HSIOM_PORT_SEL2
SW1__0__HSIOM_MASK EQU 0xF0000000
SW1__0__HSIOM_SHIFT EQU 28
SW1__0__INTCFG EQU CYREG_GPIO_PRT2_INTR_CFG
SW1__0__INTR EQU CYREG_GPIO_PRT2_INTR
SW1__0__INTR_CFG EQU CYREG_GPIO_PRT2_INTR_CFG
SW1__0__INTSTAT EQU CYREG_GPIO_PRT2_INTR
SW1__0__MASK EQU 0x80
SW1__0__PA__CFG0 EQU CYREG_UDB_PA2_CFG0
SW1__0__PA__CFG1 EQU CYREG_UDB_PA2_CFG1
SW1__0__PA__CFG10 EQU CYREG_UDB_PA2_CFG10
SW1__0__PA__CFG11 EQU CYREG_UDB_PA2_CFG11
SW1__0__PA__CFG12 EQU CYREG_UDB_PA2_CFG12
SW1__0__PA__CFG13 EQU CYREG_UDB_PA2_CFG13
SW1__0__PA__CFG14 EQU CYREG_UDB_PA2_CFG14
SW1__0__PA__CFG2 EQU CYREG_UDB_PA2_CFG2
SW1__0__PA__CFG3 EQU CYREG_UDB_PA2_CFG3
SW1__0__PA__CFG4 EQU CYREG_UDB_PA2_CFG4
SW1__0__PA__CFG5 EQU CYREG_UDB_PA2_CFG5
SW1__0__PA__CFG6 EQU CYREG_UDB_PA2_CFG6
SW1__0__PA__CFG7 EQU CYREG_UDB_PA2_CFG7
SW1__0__PA__CFG8 EQU CYREG_UDB_PA2_CFG8
SW1__0__PA__CFG9 EQU CYREG_UDB_PA2_CFG9
SW1__0__PC EQU CYREG_GPIO_PRT2_PC
SW1__0__PC2 EQU CYREG_GPIO_PRT2_PC2
SW1__0__PORT EQU 2
SW1__0__PS EQU CYREG_GPIO_PRT2_PS
SW1__0__SHIFT EQU 7
SW1__DR EQU CYREG_GPIO_PRT2_DR
SW1__DR_CLR EQU CYREG_GPIO_PRT2_DR_CLR
SW1__DR_INV EQU CYREG_GPIO_PRT2_DR_INV
SW1__DR_SET EQU CYREG_GPIO_PRT2_DR_SET
SW1__INTCFG EQU CYREG_GPIO_PRT2_INTR_CFG
SW1__INTR EQU CYREG_GPIO_PRT2_INTR
SW1__INTR_CFG EQU CYREG_GPIO_PRT2_INTR_CFG
SW1__INTSTAT EQU CYREG_GPIO_PRT2_INTR
SW1__MASK EQU 0x80
SW1__PA__CFG0 EQU CYREG_UDB_PA2_CFG0
SW1__PA__CFG1 EQU CYREG_UDB_PA2_CFG1
SW1__PA__CFG10 EQU CYREG_UDB_PA2_CFG10
SW1__PA__CFG11 EQU CYREG_UDB_PA2_CFG11
SW1__PA__CFG12 EQU CYREG_UDB_PA2_CFG12
SW1__PA__CFG13 EQU CYREG_UDB_PA2_CFG13
SW1__PA__CFG14 EQU CYREG_UDB_PA2_CFG14
SW1__PA__CFG2 EQU CYREG_UDB_PA2_CFG2
SW1__PA__CFG3 EQU CYREG_UDB_PA2_CFG3
SW1__PA__CFG4 EQU CYREG_UDB_PA2_CFG4
SW1__PA__CFG5 EQU CYREG_UDB_PA2_CFG5
SW1__PA__CFG6 EQU CYREG_UDB_PA2_CFG6
SW1__PA__CFG7 EQU CYREG_UDB_PA2_CFG7
SW1__PA__CFG8 EQU CYREG_UDB_PA2_CFG8
SW1__PA__CFG9 EQU CYREG_UDB_PA2_CFG9
SW1__PC EQU CYREG_GPIO_PRT2_PC
SW1__PC2 EQU CYREG_GPIO_PRT2_PC2
SW1__PORT EQU 2
SW1__PS EQU CYREG_GPIO_PRT2_PS
SW1__SHIFT EQU 7

/* clk */
clk__CTRL_REGISTER EQU CYREG_PERI_PCLK_CTL12
clk__DIV_ID EQU 0x00000040
clk__DIV_REGISTER EQU CYREG_PERI_DIV_16_CTL00
clk__PA_DIV_ID EQU 0x000000FF

/* LEDB */
LEDB__0__DR EQU CYREG_GPIO_PRT3_DR
LEDB__0__DR_CLR EQU CYREG_GPIO_PRT3_DR_CLR
LEDB__0__DR_INV EQU CYREG_GPIO_PRT3_DR_INV
LEDB__0__DR_SET EQU CYREG_GPIO_PRT3_DR_SET
LEDB__0__HSIOM EQU CYREG_HSIOM_PORT_SEL3
LEDB__0__HSIOM_MASK EQU 0xF0000000
LEDB__0__HSIOM_SHIFT EQU 28
LEDB__0__INTCFG EQU CYREG_GPIO_PRT3_INTR_CFG
LEDB__0__INTR EQU CYREG_GPIO_PRT3_INTR
LEDB__0__INTR_CFG EQU CYREG_GPIO_PRT3_INTR_CFG
LEDB__0__INTSTAT EQU CYREG_GPIO_PRT3_INTR
LEDB__0__MASK EQU 0x80
LEDB__0__OUT_SEL EQU CYREG_UDB_PA3_CFG10
LEDB__0__OUT_SEL_SHIFT EQU 14
LEDB__0__OUT_SEL_VAL EQU 0
LEDB__0__PA__CFG0 EQU CYREG_UDB_PA3_CFG0
LEDB__0__PA__CFG1 EQU CYREG_UDB_PA3_CFG1
LEDB__0__PA__CFG10 EQU CYREG_UDB_PA3_CFG10
LEDB__0__PA__CFG11 EQU CYREG_UDB_PA3_CFG11
LEDB__0__PA__CFG12 EQU CYREG_UDB_PA3_CFG12
LEDB__0__PA__CFG13 EQU CYREG_UDB_PA3_CFG13
LEDB__0__PA__CFG14 EQU CYREG_UDB_PA3_CFG14
LEDB__0__PA__CFG2 EQU CYREG_UDB_PA3_CFG2
LEDB__0__PA__CFG3 EQU CYREG_UDB_PA3_CFG3
LEDB__0__PA__CFG4 EQU CYREG_UDB_PA3_CFG4
LEDB__0__PA__CFG5 EQU CYREG_UDB_PA3_CFG5
LEDB__0__PA__CFG6 EQU CYREG_UDB_PA3_CFG6
LEDB__0__PA__CFG7 EQU CYREG_UDB_PA3_CFG7
LEDB__0__PA__CFG8 EQU CYREG_UDB_PA3_CFG8
LEDB__0__PA__CFG9 EQU CYREG_UDB_PA3_CFG9
LEDB__0__PC EQU CYREG_GPIO_PRT3_PC
LEDB__0__PC2 EQU CYREG_GPIO_PRT3_PC2
LEDB__0__PORT EQU 3
LEDB__0__PS EQU CYREG_GPIO_PRT3_PS
LEDB__0__SHIFT EQU 7
LEDB__DR EQU CYREG_GPIO_PRT3_DR
LEDB__DR_CLR EQU CYREG_GPIO_PRT3_DR_CLR
LEDB__DR_INV EQU CYREG_GPIO_PRT3_DR_INV
LEDB__DR_SET EQU CYREG_GPIO_PRT3_DR_SET
LEDB__INTCFG EQU CYREG_GPIO_PRT3_INTR_CFG
LEDB__INTR EQU CYREG_GPIO_PRT3_INTR
LEDB__INTR_CFG EQU CYREG_GPIO_PRT3_INTR_CFG
LEDB__INTSTAT EQU CYREG_GPIO_PRT3_INTR
LEDB__MASK EQU 0x80
LEDB__PA__CFG0 EQU CYREG_UDB_PA3_CFG0
LEDB__PA__CFG1 EQU CYREG_UDB_PA3_CFG1
LEDB__PA__CFG10 EQU CYREG_UDB_PA3_CFG10
LEDB__PA__CFG11 EQU CYREG_UDB_PA3_CFG11
LEDB__PA__CFG12 EQU CYREG_UDB_PA3_CFG12
LEDB__PA__CFG13 EQU CYREG_UDB_PA3_CFG13
LEDB__PA__CFG14 EQU CYREG_UDB_PA3_CFG14
LEDB__PA__CFG2 EQU CYREG_UDB_PA3_CFG2
LEDB__PA__CFG3 EQU CYREG_UDB_PA3_CFG3
LEDB__PA__CFG4 EQU CYREG_UDB_PA3_CFG4
LEDB__PA__CFG5 EQU CYREG_UDB_PA3_CFG5
LEDB__PA__CFG6 EQU CYREG_UDB_PA3_CFG6
LEDB__PA__CFG7 EQU CYREG_UDB_PA3_CFG7
LEDB__PA__CFG8 EQU CYREG_UDB_PA3_CFG8
LEDB__PA__CFG9 EQU CYREG_UDB_PA3_CFG9
LEDB__PC EQU CYREG_GPIO_PRT3_PC
LEDB__PC2 EQU CYREG_GPIO_PRT3_PC2
LEDB__PORT EQU 3
LEDB__PS EQU CYREG_GPIO_PRT3_PS
LEDB__SHIFT EQU 7

/* LEDR */
LEDR__0__DR EQU CYREG_GPIO_PRT2_DR
LEDR__0__DR_CLR EQU CYREG_GPIO_PRT2_DR_CLR
LEDR__0__DR_INV EQU CYREG_GPIO_PRT2_DR_INV
LEDR__0__DR_SET EQU CYREG_GPIO_PRT2_DR_SET
LEDR__0__HSIOM EQU CYREG_HSIOM_PORT_SEL2
LEDR__0__HSIOM_MASK EQU 0x0F000000
LEDR__0__HSIOM_SHIFT EQU 24
LEDR__0__INTCFG EQU CYREG_GPIO_PRT2_INTR_CFG
LEDR__0__INTR EQU CYREG_GPIO_PRT2_INTR
LEDR__0__INTR_CFG EQU CYREG_GPIO_PRT2_INTR_CFG
LEDR__0__INTSTAT EQU CYREG_GPIO_PRT2_INTR
LEDR__0__MASK EQU 0x40
LEDR__0__OUT_SEL EQU CYREG_UDB_PA2_CFG10
LEDR__0__OUT_SEL_SHIFT EQU 12
LEDR__0__OUT_SEL_VAL EQU 2
LEDR__0__PA__CFG0 EQU CYREG_UDB_PA2_CFG0
LEDR__0__PA__CFG1 EQU CYREG_UDB_PA2_CFG1
LEDR__0__PA__CFG10 EQU CYREG_UDB_PA2_CFG10
LEDR__0__PA__CFG11 EQU CYREG_UDB_PA2_CFG11
LEDR__0__PA__CFG12 EQU CYREG_UDB_PA2_CFG12
LEDR__0__PA__CFG13 EQU CYREG_UDB_PA2_CFG13
LEDR__0__PA__CFG14 EQU CYREG_UDB_PA2_CFG14
LEDR__0__PA__CFG2 EQU CYREG_UDB_PA2_CFG2
LEDR__0__PA__CFG3 EQU CYREG_UDB_PA2_CFG3
LEDR__0__PA__CFG4 EQU CYREG_UDB_PA2_CFG4
LEDR__0__PA__CFG5 EQU CYREG_UDB_PA2_CFG5
LEDR__0__PA__CFG6 EQU CYREG_UDB_PA2_CFG6
LEDR__0__PA__CFG7 EQU CYREG_UDB_PA2_CFG7
LEDR__0__PA__CFG8 EQU CYREG_UDB_PA2_CFG8
LEDR__0__PA__CFG9 EQU CYREG_UDB_PA2_CFG9
LEDR__0__PC EQU CYREG_GPIO_PRT2_PC
LEDR__0__PC2 EQU CYREG_GPIO_PRT2_PC2
LEDR__0__PORT EQU 2
LEDR__0__PS EQU CYREG_GPIO_PRT2_PS
LEDR__0__SHIFT EQU 6
LEDR__DR EQU CYREG_GPIO_PRT2_DR
LEDR__DR_CLR EQU CYREG_GPIO_PRT2_DR_CLR
LEDR__DR_INV EQU CYREG_GPIO_PRT2_DR_INV
LEDR__DR_SET EQU CYREG_GPIO_PRT2_DR_SET
LEDR__INTCFG EQU CYREG_GPIO_PRT2_INTR_CFG
LEDR__INTR EQU CYREG_GPIO_PRT2_INTR
LEDR__INTR_CFG EQU CYREG_GPIO_PRT2_INTR_CFG
LEDR__INTSTAT EQU CYREG_GPIO_PRT2_INTR
LEDR__MASK EQU 0x40
LEDR__PA__CFG0 EQU CYREG_UDB_PA2_CFG0
LEDR__PA__CFG1 EQU CYREG_UDB_PA2_CFG1
LEDR__PA__CFG10 EQU CYREG_UDB_PA2_CFG10
LEDR__PA__CFG11 EQU CYREG_UDB_PA2_CFG11
LEDR__PA__CFG12 EQU CYREG_UDB_PA2_CFG12
LEDR__PA__CFG13 EQU CYREG_UDB_PA2_CFG13
LEDR__PA__CFG14 EQU CYREG_UDB_PA2_CFG14
LEDR__PA__CFG2 EQU CYREG_UDB_PA2_CFG2
LEDR__PA__CFG3 EQU CYREG_UDB_PA2_CFG3
LEDR__PA__CFG4 EQU CYREG_UDB_PA2_CFG4
LEDR__PA__CFG5 EQU CYREG_UDB_PA2_CFG5
LEDR__PA__CFG6 EQU CYREG_UDB_PA2_CFG6
LEDR__PA__CFG7 EQU CYREG_UDB_PA2_CFG7
LEDR__PA__CFG8 EQU CYREG_UDB_PA2_CFG8
LEDR__PA__CFG9 EQU CYREG_UDB_PA2_CFG9
LEDR__PC EQU CYREG_GPIO_PRT2_PC
LEDR__PC2 EQU CYREG_GPIO_PRT2_PC2
LEDR__PORT EQU 2
LEDR__PS EQU CYREG_GPIO_PRT2_PS
LEDR__SHIFT EQU 6

/* PWM2_PWMUDB */
PWM2_PWMUDB_genblk1_ctrlreg__7__MASK EQU 0x80
PWM2_PWMUDB_genblk1_ctrlreg__7__POS EQU 7
PWM2_PWMUDB_genblk1_ctrlreg__CONTROL_AUX_CTL_REG EQU CYREG_UDB_W8_ACTL_03
PWM2_PWMUDB_genblk1_ctrlreg__CONTROL_REG EQU CYREG_UDB_W8_CTL_03
PWM2_PWMUDB_genblk1_ctrlreg__CONTROL_ST_REG EQU CYREG_UDB_CAT16_CTL_ST_03
PWM2_PWMUDB_genblk1_ctrlreg__COUNT_REG EQU CYREG_UDB_W8_CTL_03
PWM2_PWMUDB_genblk1_ctrlreg__COUNT_ST_REG EQU CYREG_UDB_CAT16_CTL_ST_03
PWM2_PWMUDB_genblk1_ctrlreg__MASK EQU 0x80
PWM2_PWMUDB_genblk1_ctrlreg__MASK_CTL_AUX_CTL_REG EQU CYREG_UDB_CAT16_ACTL_MSK_03
PWM2_PWMUDB_genblk1_ctrlreg__PER_CTL_AUX_CTL_REG EQU CYREG_UDB_CAT16_ACTL_MSK_03
PWM2_PWMUDB_genblk1_ctrlreg__PERIOD_REG EQU CYREG_UDB_W8_MSK_03
PWM2_PWMUDB_genblk8_stsreg__0__MASK EQU 0x01
PWM2_PWMUDB_genblk8_stsreg__0__POS EQU 0
PWM2_PWMUDB_genblk8_stsreg__2__MASK EQU 0x04
PWM2_PWMUDB_genblk8_stsreg__2__POS EQU 2
PWM2_PWMUDB_genblk8_stsreg__3__MASK EQU 0x08
PWM2_PWMUDB_genblk8_stsreg__3__POS EQU 3
PWM2_PWMUDB_genblk8_stsreg__MASK EQU 0x0D
PWM2_PWMUDB_genblk8_stsreg__MASK_REG EQU CYREG_UDB_W8_MSK_03
PWM2_PWMUDB_genblk8_stsreg__MASK_ST_AUX_CTL_REG EQU CYREG_UDB_CAT16_ACTL_MSK_03
PWM2_PWMUDB_genblk8_stsreg__PER_ST_AUX_CTL_REG EQU CYREG_UDB_CAT16_ACTL_MSK_03
PWM2_PWMUDB_genblk8_stsreg__STATUS_AUX_CTL_REG EQU CYREG_UDB_W8_ACTL_03
PWM2_PWMUDB_genblk8_stsreg__STATUS_CNT_REG EQU CYREG_UDB_CAT16_CTL_ST_03
PWM2_PWMUDB_genblk8_stsreg__STATUS_CONTROL_REG EQU CYREG_UDB_CAT16_CTL_ST_03
PWM2_PWMUDB_genblk8_stsreg__STATUS_REG EQU CYREG_UDB_W8_ST_03
PWM2_PWMUDB_sP8_pwmdp_u0__A0_A1_REG EQU CYREG_UDB_CAT16_A_03
PWM2_PWMUDB_sP8_pwmdp_u0__A0_REG EQU CYREG_UDB_W8_A0_03
PWM2_PWMUDB_sP8_pwmdp_u0__A1_REG EQU CYREG_UDB_W8_A1_03
PWM2_PWMUDB_sP8_pwmdp_u0__D0_D1_REG EQU CYREG_UDB_CAT16_D_03
PWM2_PWMUDB_sP8_pwmdp_u0__D0_REG EQU CYREG_UDB_W8_D0_03
PWM2_PWMUDB_sP8_pwmdp_u0__D1_REG EQU CYREG_UDB_W8_D1_03
PWM2_PWMUDB_sP8_pwmdp_u0__DP_AUX_CTL_REG EQU CYREG_UDB_W8_ACTL_03
PWM2_PWMUDB_sP8_pwmdp_u0__F0_F1_REG EQU CYREG_UDB_CAT16_F_03
PWM2_PWMUDB_sP8_pwmdp_u0__F0_REG EQU CYREG_UDB_W8_F0_03
PWM2_PWMUDB_sP8_pwmdp_u0__F1_REG EQU CYREG_UDB_W8_F1_03
PWM2_PWMUDB_sP8_pwmdp_u0__MSK_DP_AUX_CTL_REG EQU CYREG_UDB_CAT16_ACTL_MSK_03
PWM2_PWMUDB_sP8_pwmdp_u0__PER_DP_AUX_CTL_REG EQU CYREG_UDB_CAT16_ACTL_MSK_03

/* clk2 */
clk2__CTRL_REGISTER EQU CYREG_PERI_PCLK_CTL14
clk2__DIV_ID EQU 0x00000041
clk2__DIV_REGISTER EQU CYREG_PERI_DIV_16_CTL01
clk2__PA_DIV_ID EQU 0x000000FF

/* Miscellaneous */
CYDEV_BCLK__HFCLK__HZ EQU 24000000
CYDEV_BCLK__HFCLK__KHZ EQU 24000
CYDEV_BCLK__HFCLK__MHZ EQU 24
CYDEV_BCLK__SYSCLK__HZ EQU 24000000
CYDEV_BCLK__SYSCLK__KHZ EQU 24000
CYDEV_BCLK__SYSCLK__MHZ EQU 24
CYDEV_CHIP_DIE_LEOPARD EQU 1
CYDEV_CHIP_DIE_PANTHER EQU 6
CYDEV_CHIP_DIE_PSOC4A EQU 3
CYDEV_CHIP_DIE_PSOC5LP EQU 5
CYDEV_CHIP_DIE_UNKNOWN EQU 0
CYDEV_CHIP_FAMILY_PSOC3 EQU 1
CYDEV_CHIP_FAMILY_PSOC4 EQU 2
CYDEV_CHIP_FAMILY_PSOC5 EQU 3
CYDEV_CHIP_FAMILY_UNKNOWN EQU 0
CYDEV_CHIP_FAMILY_USED EQU CYDEV_CHIP_FAMILY_PSOC4
CYDEV_CHIP_JTAG_ID EQU 0x0E34119E
CYDEV_CHIP_MEMBER_3A EQU 1
CYDEV_CHIP_MEMBER_4A EQU 3
CYDEV_CHIP_MEMBER_4D EQU 2
CYDEV_CHIP_MEMBER_4F EQU 4
CYDEV_CHIP_MEMBER_5A EQU 6
CYDEV_CHIP_MEMBER_5B EQU 5
CYDEV_CHIP_MEMBER_UNKNOWN EQU 0
CYDEV_CHIP_MEMBER_USED EQU CYDEV_CHIP_MEMBER_4F
CYDEV_CHIP_DIE_EXPECT EQU CYDEV_CHIP_MEMBER_USED
CYDEV_CHIP_DIE_ACTUAL EQU CYDEV_CHIP_DIE_EXPECT
CYDEV_CHIP_REV_LEOPARD_ES1 EQU 0
CYDEV_CHIP_REV_LEOPARD_ES2 EQU 1
CYDEV_CHIP_REV_LEOPARD_ES3 EQU 3
CYDEV_CHIP_REV_LEOPARD_PRODUCTION EQU 3
CYDEV_CHIP_REV_PANTHER_ES0 EQU 0
CYDEV_CHIP_REV_PANTHER_ES1 EQU 1
CYDEV_CHIP_REV_PANTHER_PRODUCTION EQU 1
CYDEV_CHIP_REV_PSOC4A_ES0 EQU 17
CYDEV_CHIP_REV_PSOC4A_PRODUCTION EQU 17
CYDEV_CHIP_REV_PSOC5LP_ES0 EQU 0
CYDEV_CHIP_REV_PSOC5LP_PRODUCTION EQU 0
CYDEV_CHIP_REVISION_3A_ES1 EQU 0
CYDEV_CHIP_REVISION_3A_ES2 EQU 1
CYDEV_CHIP_REVISION_3A_ES3 EQU 3
CYDEV_CHIP_REVISION_3A_PRODUCTION EQU 3
CYDEV_CHIP_REVISION_4A_ES0 EQU 17
CYDEV_CHIP_REVISION_4A_PRODUCTION EQU 17
CYDEV_CHIP_REVISION_4D_PRODUCTION EQU 0
CYDEV_CHIP_REVISION_4F_PRODUCTION EQU 0
CYDEV_CHIP_REVISION_5A_ES0 EQU 0
CYDEV_CHIP_REVISION_5A_ES1 EQU 1
CYDEV_CHIP_REVISION_5A_PRODUCTION EQU 1
CYDEV_CHIP_REVISION_5B_ES0 EQU 0
CYDEV_CHIP_REVISION_5B_PRODUCTION EQU 0
CYDEV_CHIP_REVISION_USED EQU CYDEV_CHIP_REVISION_4F_PRODUCTION
CYDEV_CHIP_REV_EXPECT EQU CYDEV_CHIP_REVISION_USED
CYDEV_CONFIG_READ_ACCELERATOR EQU 1
CYDEV_CONFIG_UNUSED_IO_AllowButWarn EQU 0
CYDEV_CONFIG_UNUSED_IO EQU CYDEV_CONFIG_UNUSED_IO_AllowButWarn
CYDEV_CONFIG_UNUSED_IO_AllowWithInfo EQU 1
CYDEV_CONFIG_UNUSED_IO_Disallowed EQU 2
CYDEV_CONFIGURATION_COMPRESSED EQU 1
CYDEV_CONFIGURATION_MODE_COMPRESSED EQU 0
CYDEV_CONFIGURATION_MODE EQU CYDEV_CONFIGURATION_MODE_COMPRESSED
CYDEV_CONFIGURATION_MODE_DMA EQU 2
CYDEV_CONFIGURATION_MODE_UNCOMPRESSED EQU 1
CYDEV_DEBUG_PROTECT_KILL EQU 4
CYDEV_DEBUG_PROTECT_OPEN EQU 1
CYDEV_DEBUG_PROTECT EQU CYDEV_DEBUG_PROTECT_OPEN
CYDEV_DEBUG_PROTECT_PROTECTED EQU 2
CYDEV_DEBUGGING_DPS_Disable EQU 3
CYDEV_DEBUGGING_DPS_SWD EQU 2
CYDEV_DEBUGGING_DPS EQU CYDEV_DEBUGGING_DPS_SWD
CYDEV_DEBUGGING_ENABLE EQU 1
CYDEV_HEAP_SIZE EQU 0x0100
CYDEV_PROJ_TYPE EQU 0
CYDEV_PROJ_TYPE_BOOTLOADER EQU 1
CYDEV_PROJ_TYPE_LOADABLE EQU 2
CYDEV_PROJ_TYPE_MULTIAPPBOOTLOADER EQU 3
CYDEV_PROJ_TYPE_STANDARD EQU 0
CYDEV_STACK_SIZE EQU 0x0400
CYDEV_USE_BUNDLED_CMSIS EQU 1
CYDEV_VARIABLE_VDDA EQU 1
CYDEV_VDDA_MV EQU 3300
CYDEV_VDDD_MV EQU 3300
CYDEV_VDDR_MV EQU 3300
CYIPBLOCK_m0s8bless_VERSION EQU 1
CYIPBLOCK_m0s8cpussv2_VERSION EQU 1
CYIPBLOCK_m0s8csd_VERSION EQU 1
CYIPBLOCK_m0s8ioss_VERSION EQU 1
CYIPBLOCK_m0s8lcd_VERSION EQU 2
CYIPBLOCK_m0s8lpcomp_VERSION EQU 2
CYIPBLOCK_m0s8peri_VERSION EQU 1
CYIPBLOCK_m0s8scb_VERSION EQU 2
CYIPBLOCK_m0s8srssv2_VERSION EQU 1
CYIPBLOCK_m0s8tcpwm_VERSION EQU 2
CYIPBLOCK_m0s8udbif_VERSION EQU 1
CYIPBLOCK_s8pass4al_VERSION EQU 1
CYDEV_BOOTLOADER_ENABLE EQU 0

#endif /* INCLUDED_CYFITTERIAR_INC */
